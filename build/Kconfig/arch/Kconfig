## build/Kconfig/arch/Kconfig
```kconfig
# Load Zephyr Arch Kconfig descriptions.
osource "/home/gui/zephyrproject/zephyr/arch/x86/Kconfig"
osource "/home/gui/zephyrproject/zephyr/arch/xtensa/Kconfig"
osource "/home/gui/zephyrproject/zephyr/arch/sparc/Kconfig"
osource "/home/gui/zephyrproject/zephyr/arch/riscv/Kconfig"
osource "/home/gui/zephyrproject/zephyr/arch/posix/Kconfig"
osource "/home/gui/zephyrproject/zephyr/arch/nios2/Kconfig"
osource "/home/gui/zephyrproject/zephyr/arch/mips/Kconfig"
osource "/home/gui/zephyrproject/zephyr/arch/arm64/Kconfig"
osource "/home/gui/zephyrproject/zephyr/arch/arm/Kconfig"
osource "/home/gui/zephyrproject/zephyr/arch/arc/Kconfig"
```

## build/Kconfig/boards/Kconfig.defconfig
```kconfig
# Load Zephyr board defconfig descriptions.
osource "/home/gui/zephyrproject/zephyr/boards/native/native_sim/Kconfig.defconfig"
```

## build/Kconfig/boards/Kconfig.sysbuild
```kconfig
# Load Sysbuild board Kconfig descriptions.
osource "/home/gui/zephyrproject/zephyr/boards/native/native_sim/Kconfig.sysbuild"
```
