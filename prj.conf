## prj.conf
```kconfig
# Pins are configured through the GPIO driver API.
CONFIG_GPIO=y

# native_sim instantiates a zephyr,gpio-emul controller.
CONFIG_GPIO_EMUL=y

# sw0 is described as gpio-keys, but this application owns the pin.
# The input driver would claim it and disconnect it under runtime PM.
CONFIG_INPUT_GPIO_KEYS=n
```

## app.overlay
```dts
/* SPDX-License-Identifier: Apache-2.0 */
/*
 * Button for Activity 03. native_sim already provides led0 on gpio0 pin 0.
 * sw0 is gpio0 pin 1 and is active high, same polarity as the LED.
 */

#include <zephyr/dt-bindings/input/input-event-codes.h>

/ {
	aliases {
		sw0 = &sw0;
	};

	buttons {
		compatible = "gpio-keys";

		sw0: button_0 {
			gpios = <&gpio0 1 GPIO_ACTIVE_HIGH>;
			zephyr,code = <INPUT_KEY_0>;
		};
	};
};
```

## src/main.c
```c
/*******************************************************************
 * @file main.c
 *
 * @brief Main file.
 * @author João Matheus Nascimento Dias (jmnd@ic.ufal.br)
 * @author José Félix de Oliveira Neto (jfon@ic.ufal.br)
 * @version 0.1
 * @date 26/08/2026
 *******************************************************************/

#include "board_io.h"

#include <stddef.h>

#include <zephyr/drivers/gpio.h>
#include <zephyr/drivers/gpio/gpio_emul.h>
#include <zephyr/kernel.h>
#include <zephyr/sys/printk.h>
#include <zephyr/sys/util.h>

int main(void)
{
	static const int sequence[] = {0, 1, 0, 1};
	const struct gpio_dt_spec button = GPIO_DT_SPEC_GET(DT_ALIAS(sw0), gpios);
	int ret;

	ret = io_init();
	if (ret < 0) {
		printk("io_init failed: %d\n", ret);
		return 0;
	}

	for (size_t i = 0; i < ARRAY_SIZE(sequence); i++) {
		int level;

		/* Emulator is the external contact. board_io only reads the pin. */
		ret = gpio_emul_input_set(button.port, button.pin, sequence[i]);
		if (ret < 0) {
			printk("gpio_emul_input_set failed: %d\n", ret);
			return 0;
		}

		level = button_read();
		if (level < 0) {
			printk("button_read failed: %d\n", level);
			return 0;
		}

		ret = led_set(level != 0);
		if (ret < 0) {
			printk("led_set failed: %d\n", ret);
			return 0;
		}

		printk("Button: %d -> LED: %d\n", level, level);
	}

	return 0;
}
```

## src/board_io.c
```c
/* SPDX-License-Identifier: Apache-2.0 */

/*******************************************************************
 * @file board_io.c
 *
 * @brief Módulo de entradas/saídas (Atividade-03).
 *******************************************************************/

#include "board_io.h"

#include <errno.h>

#include <zephyr/drivers/gpio.h>

static const struct gpio_dt_spec led = GPIO_DT_SPEC_GET(DT_ALIAS(led0), gpios);
static const struct gpio_dt_spec button = GPIO_DT_SPEC_GET(DT_ALIAS(sw0), gpios);

int io_init(void)
{
	int ret;

	if (!gpio_is_ready_dt(&led) || !gpio_is_ready_dt(&button)) {
		return -ENODEV;
	}

	ret = gpio_pin_configure_dt(&led, GPIO_OUTPUT_INACTIVE);
	if (ret < 0) {
		return ret;
	}

	return gpio_pin_configure_dt(&button, GPIO_INPUT);
}

int led_set(bool on)
{
	/* Logical 1 is active. gpio_pin_set_dt takes an int, not bool. */
	return gpio_pin_set_dt(&led, on ? 1 : 0);
}

int button_read(void)
{
	return gpio_pin_get_dt(&button);
}
```

## src/command.c
```c
#include "command.h"
#include <stddef.h>

void command_execute(const command_t *cmd)
{
	if (cmd != NULL && cmd->execute != NULL) {
		cmd->execute();
	}
}
```

## src/command.h
```c
#ifndef COMMAND_H
#define COMMAND_H

typedef struct {
	const char *name;
	void (*execute)(void);
} command_t;

void command_execute(const command_t *cmd);

#endif
```

## src/commands.c
```c
#include "command.h"
#include "commands.h"
#include <string.h>
#include <zephyr/sys/printk.h>

static void action_ping(void)
{
	printk("Executando: Pong!\n");
}

static void action_led_on(void)
{
	printk("Executando: Ligando o LED...\n");
}

static const command_t command_table[] = {{"ping", action_ping}, {"led_on", action_led_on}};

#define NUM_COMMANDS (sizeof(command_table) / sizeof(command_table[0]))

void dispatch_command(const char *cmd_name)
{
	for (int i = 0; i < NUM_COMMANDS; i++) {
		if (strcmp(command_table[i].name, cmd_name) == 0) {
			command_execute(&command_table[i]);
			return;
		}
	}
	printk("Erro: Comando '%s' nao encontrado.\n", cmd_name);
}
```

## src/commands.h
```c
#ifndef COMMANDS_H
#define COMMANDS_H

void dispatch_command(const char *cmd_name);

#endif
```
